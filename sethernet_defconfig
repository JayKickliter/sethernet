## sethernet_defconfig
```kconfig
CONFIG_UART_INTERRUPT_DRIVEN=y
# CONFIG_NET_IPV6 is not set
CONFIG_UART_MCUX_0=y
CONFIG_SYS_CLOCK_HW_CYCLES_PER_SEC=120000000
CONFIG_CORTEX_M_SYSTICK=y
CONFIG_SOC_SERIES_KINETIS_K6X=y
CONFIG_ARM_MPU=y
CONFIG_ARM=y
CONFIG_SERIAL=y
CONFIG_UART_LINE_CTRL=y
CONFIG_UART_DRV_CMD=y
CONFIG_PINMUX=y
CONFIG_NETWORKING=y
CONFIG_NET_HOSTNAME_ENABLE=y
CONFIG_NET_HOSTNAME="hawkeye"
CONFIG_NET_TCP=y
CONFIG_NET_CONFIG_NEED_IPV4=y
CONFIG_NET_CONFIG_SETTINGS=y
CONFIG_NET_CONFIG_MY_IPV4_ADDR="192.168.2.51"
CONFIG_NET_CONFIG_MY_IPV4_GW="192.168.2.1"
CONFIG_NET_SOCKETS=y
CONFIG_NET_SOCKETS_POSIX_NAMES=y
```
